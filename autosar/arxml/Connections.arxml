AUTOSAR XML (schema 4-2-2)
package /SwCompType
  composition sw component type Composition
    component SPD: type=SPD
    component TLT: type=TLT
    connectors:
      provider=SPD_PPort_SendData, requester=TLT_RPort_GetData
      provider=P_ServerPort, requester=R_ClientPort
      provider=TLT.PP_TLT_ModeSwitch, requester=SPD.RP_SPD_ModeSwitch
